## camkes_cli/templates/build_templates/sel4/Kconfig
```kconfig
mainmenu "CAmkES project configuration"

config COMMON_PATH
    string
    option env="COMMON_PATH"

menu "Kernel"
    source "kernel/Kconfig"
endmenu

menu "Libraries"
    source "libs/libmuslc/Kconfig"
    source "libs/libsel4/Kconfig"
    source "libs/libsel4muslcsys/Kconfig"
    source "libs/libsel4muslccamkes/Kconfig"
    source "libs/libsel4platsupport/Kconfig"
    source "libs/libsel4utils/Kconfig"
    source "libs/libcpio/Kconfig"
    source "libs/libelf/Kconfig"
    source "libs/libsel4bench/Kconfig"
    source "libs/libsel4sync/Kconfig"
    source "libs/libsel4vspace/Kconfig"
    source "libs/libsel4vka/Kconfig"
    source "libs/libplatsupport/Kconfig"
    source "libs/libsel4debug/Kconfig"
    source "libs/libutils/Kconfig"
    source "libs/libsel4simple/Kconfig"
    source "libs/libsel4simple-default/Kconfig"
    source "libs/libsel4bga/Kconfig"
endmenu

menu "Applications"
    source "apps/capdl-loader-experimental/Kconfig"
    source "apps/{{ name }}/Kconfig"
endmenu

source "tools/camkes/Kconfig"
source "$COMMON_PATH/Kconfig"
```

## templates/Kconfig
```kconfig
config APP_{{ name.upper() }}
    bool "CAmkES application: {{ name }}"
    default n
    help
        CAmkES application: {{ name }}
```
